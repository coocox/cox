/**
  *******************************************************************
  * Chip: MKL25Z128VLK4
  * NOTE: This file is generated by CoIDE and Included by *link.ld
  *       It is used to describe which memory regions may be used
  *       by the linker.
  *******************************************************************
  * Internal memory map
  *   Region      Start           Size
  *   flash0      0x00000000      0x00020000
  *   sram0       0x20000000      0x00003000
  *   sram1       0x1FFFE000      0x00001000
  *******************************************************************
*/

MEMORY
{
	rom (rx)  : ORIGIN = 0x00000000, LENGTH = 0x00020000
	ram (rwx) : ORIGIN = 0x20000000, LENGTH = 0x00003000
	ram1 (rwx) : ORIGIN = 0x1FFFE000, LENGTH = 0x00001000
}

_eram = 0x20000000 + 0x00003000;