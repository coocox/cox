/**
  *******************************************************************
  * Chip: NUC100VE3AN
  * NOTE: This file is generated by CoIDE and Included by link.ld
  *       It is used to describe which memory regions may be used
  *       by the linker.
  *******************************************************************
  * Internal memory map
  *   Region      Start           Size
  *   flash0      0x00000000      0x00003FFF
  *   sram0       0x20000000      0x000007FF
  *******************************************************************
*/

MEMORY
{
	rom (rx)  : ORIGIN = 0x00000000, LENGTH = 0x00003FFF
	ram (rwx) : ORIGIN = 0x20000000, LENGTH = 0x000007FF
}

_eram = 0x20000000 + 0x000007FF;